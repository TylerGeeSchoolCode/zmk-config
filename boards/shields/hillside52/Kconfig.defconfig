## boards/shields/hillside52/Kconfig.defconfig
```kconfig
if SHIELD_HILLSIDE52_LEFT
    config ZMK_KEYBOARD_NAME
        default "Hillside52"

    config ZMK_USB
        default y
    config ZMK_USB_BOOT
        default y

    config BT_MAX_CONN
        default 5
    config BT_MAX_PAIRED
        default 5

    config ZMK_SPLIT_PERIPHERAL_HID_INDICATORS
        default y

    config ZMK_SPLIT_BLE_CENTRAL_BATTERY_LEVEL_FETCHING
        default y
    config ZMK_SPLIT_BLE_CENTRAL_BATTERY_LEVEL_PROXY
        default y

    config ZMK_SPLIT_BLE_CENTRAL_POSITION_QUEUE_SIZE
        default 16
    config ZMK_SPLIT_BLE_CENTRAL_SPLIT_RUN_QUEUE_SIZE
        default 16

    config ZMK_STUDIO
        default y
    config ZMK_STUDIO_LOCKING
        default y
    config ZMK_STUDIO_LOCK_IDLE_TIMEOUT_SEC
        default 500
    config ZMK_STUDIO_LOCK_ON_DISCONNECT
        default y

    config ZMK_WPM
        default y
endif # SHIELD_HILLSIDE52_LEFT

if SHIELD_HILLSIDE52_RIGHT
    config ZMK_SPLIT_ROLE_CENTRAL
        default n

    config BT_MAX_CONN
        default 1
    config BT_MAX_PAIRED
        default 1

    config ZMK_EXT_POWER
        default y
endif # SHIELD_HILLSIDE52_RIGHT

if SHIELD_HILLSIDE52_LEFT || SHIELD_HILLSIDE52_RIGHT
    config ZMK_SPLIT
        default y

    config ZMK_BLE
        default y

    config ZMK_SPLIT_BLE
        default y

endif # SHIELD_HILLSIDE52_LEFT || SHIELD_HILLSIDE52_RIGHT
```

## boards/shields/hillside52/Kconfig.shield
```kconfig
config SHIELD_HILLSIDE52_LEFT
    def_bool $(shields_list_contains,hillside52_left)

config SHIELD_HILLSIDE52_RIGHT
    def_bool $(shields_list_contains,hillside52_right)
```

## config/boards/shields/hillside52_dongle/Kconfig.shield
```kconfig
# No whitespace after the comma or in the keyboard name!
config SHIELD_HILLSIDE52_DONGLE
    def_bool $(shields_list_contains,hillside52_dongle)
```

## dongle-module/boards/shields/hillside52_dongle/Kconfig.defconfig
```kconfig
if SHIELD_HILLSIDE52_DONGLE 

# Max 16 characters in keyboard name
config ZMK_KEYBOARD_NAME
    default "Hillside52 USB"

config ZMK_SPLIT_ROLE_CENTRAL
    default y

config ZMK_SPLIT
    default y

config ZMK_SPLIT_BLE_CENTRAL_PERIPHERALS
    default 2

# ZMK_SPLIT_BLE_CENTRAL_PERIPHERALS + Desired number of BT profiles (default is 5)
config BT_MAX_CONN
    default 6

# Set this to the same number as BT_MAX_CONN
config BT_MAX_PAIRED
    default 6

endif
```

## dongle-module/extra-config/west.yml
```yaml
manifest:
  remotes:
    - name: zmkfirmware
      url-base: https://github.com/zmkfirmware
  projects:
    - name: zmk
      remote: zmkfirmware
      revision: main
      import: app/west.yml
    - name: hillside52_dongle
      path: dongle-module
      revision: main
  self:
    path: config
```
