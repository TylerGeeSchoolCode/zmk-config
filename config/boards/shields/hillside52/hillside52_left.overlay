#include "hillside52.dtsi"

/ {
    chosen {
        zmk,physical_layout = &kscan0;
    };
};

&kscan0 {
    col-gpios 
        = <&pro_micro 19 GPIO_ACTIVE_HIGH>  // col0
        , <&pro_micro 18 GPIO_ACTIVE_HIGH>  // col1
        , <&pro_micro 15 GPIO_ACTIVE_HIGH>  // col2
        , <&pro_micro 14 GPIO_ACTIVE_HIGH>  // col3
        , <&pro_micro 16 GPIO_ACTIVE_HIGH>  // col4
        , <&pro_micro 10 GPIO_ACTIVE_HIGH>  // col5
        ;
};

&left_encoder {
    status = "okay";
};
