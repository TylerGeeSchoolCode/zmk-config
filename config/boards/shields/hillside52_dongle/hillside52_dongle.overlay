
/*
   Dongle overlay for Hillside52 split keyboard
   Copies keyboard matrix transform to satisfy ZMK linker
*/

#include <dt-bindings/zmk/matrix_transform.h>
#include "../hillside52/hillside52_left.overlay"
#include "../hillside52/hillside52_right.overlay"

/ {
    chosen {
        /* Use the existing keyboard transform */
        zmk,kscan = &mock_kscan;          /* mock kscan for dongle */
        zmk,physical-layout = &default_transform;  /* pull from included overlay */
    };

    /* Define a mock kscan (no keys) */
    mock_kscan: mock_kscan_0 {
        compatible = "zmk,kscan-mock";
        columns = <0>;
        rows = <0>;
        events = <0>;
    };
};